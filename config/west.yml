## config/west.yml
```yaml
manifest:
  remotes:
    - name: zmkfirmware
      url-base: https://github.com/zmkfirmware
    - name: voidyourwarranty
      url-base: https://github.com/voidyourwarranty2
  projects:
    - name: zmk
      remote: zmkfirmware
      revision: v0.3
      import: app/west.yml
    # - name: zmk
    #   remote: voidyourwarranty
    #   revision: devel-adaptive
    #   import: app/west.yml
  self:
    path: config
```
